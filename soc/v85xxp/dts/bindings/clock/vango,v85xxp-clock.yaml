## soc/v85xxp/dts/bindings/clock/vango,v85xxp-clock.yaml
```yaml
description: Vango V85XXP Clock Controller
compatible: "v85xxp,clock"
include: [clock-controller.yaml, base.yaml]
clock-cells:
  - id
properties:
    reg:
      required: true
```

## soc/v85xxp/dts/bindings/counter/v85xxp,tmr-counter.yaml
```yaml
description: V85XXP timer counter

compatible: "v85xxp,tmr-counter"

include: base.yaml

properties:
  reg:
    required: true

  interrupts:
    required: true

  max-top-value:
    type: int
```

## soc/v85xxp/dts/bindings/dma/v85xxp,dma.yaml
```yaml
description: V85XXP DMA controller

compatible: "v85xxp,dma"

include:
  - name: dma-controller.yaml
  - name: base.yaml

properties:
  reg:
    required: true

  interrupts:
    required: true

  "#dma-cells":
    const: 1

  dma-channels:
    required: true

  dma-requests:
    required: true
```

## soc/v85xxp/dts/bindings/dma/vango,v85xxp-dma.yaml
```yaml
description: Vango V85XXP DMA Controller
compatible: "v85xxp,dma"
include: [dma-controller.yaml, base.yaml]
dma-cells:
  - channel
properties:
    reg:
      required: true
    interrupts:
      required: true
    clocks:
      required: true
    dma-channels:
      type: int
      required: true
    dma-requests:
      type: int
      required: true
```

## soc/v85xxp/dts/bindings/flash/v85xxp,flash-controller.yaml
```yaml
description: V85XXP internal flash controller

compatible: "v85xxp,flash-controller"

include: base.yaml

properties:
  reg:
    required: true
```

## soc/v85xxp/dts/bindings/gpio/v85xxp,gpio.yaml
```yaml
description: V85XXP GPIO controller

compatible: "v85xxp,gpio"

include:
  - name: gpio-controller.yaml
  - name: base.yaml

properties:
  reg:
    required: true

  "#gpio-cells":
    const: 2
```

## soc/v85xxp/dts/bindings/gpio/vango,v85xxp-gpio.yaml
```yaml
description: Vango V85XXP GPIO Controller
compatible: "v85xxp,gpio"
include: [gpio-controller.yaml, base.yaml]
gpio-cells:
  - pin
  - flags
properties:
    reg:
      required: true
    ngpios:
      type: int
      required: true
    clocks:
      required: false
```

## soc/v85xxp/dts/bindings/i2c/v85xxp,i2c.yaml
```yaml
description: V85XXP I2C controller

compatible: "v85xxp,i2c"

include:
  - name: i2c-controller.yaml
  - name: base.yaml

properties:
  reg:
    required: true

  interrupts:
    required: true
```

## soc/v85xxp/dts/bindings/lcd/v85xxp,lcd.yaml
```yaml
# Copyright (c) 2026 Vango Technologies
# SPDX-License-Identifier: Apache-2.0

description: V85XXP Segment LCD Controller

compatible: "v85xxp,lcd"

include: base.yaml

properties:
  reg:
    required: true

  clocks:
    required: true

  lcd_type:
    type: int
    default: 0
    description: |
      COM multiplexing mode:
        0 = 4-COM (LCD_TYPE_4COM)
        1 = 6-COM (LCD_TYPE_6COM)
        2 = 8-COM (LCD_TYPE_8COM)

  lcd_drv:
    type: int
    default: 0
    description: |
      Driving resistance:
        0 = 300 ohm (LCD_DRV_300)
        1 = 600 ohm (LCD_DRV_600)
        2 = 150 ohm (LCD_DRV_150)
        3 = 200 ohm (LCD_DRV_200)

  lcd_freq:
    type: int
    default: 1
    description: |
      Scan frequency:
        0 = 64 Hz (LCD_FRQ_64H)
        1 = 128 Hz (LCD_FRQ_128H)
        2 = 256 Hz (LCD_FRQ_256H)
        3 = 512 Hz (LCD_FRQ_512H)

  lcd_bias:
    type: int
    default: 0
    description: |
      Bias selection:
        0 = DIV3 (LCD_BMODE_DIV3)
        1 = DIV4 (LCD_BMODE_DIV4, ANA_REG6_LCDBMODE)

  lcd_voltage:
    type: int
    default: 0
    description: |
      VLCD voltage selection, 0-15 (see AN A_REG6_VLCD values)
```

## soc/v85xxp/dts/bindings/pinctrl/vango,v85xxp-pinctrl.yaml
```yaml
# Copyright (c) 2026 Vango Technologies
# SPDX-License-Identifier: Apache-2.0

description: Vango V85XXP Pinctrl
compatible: "v85xxp,pinctrl"
include: [base.yaml]
properties:
    reg:
      required: true

child-binding:
  description: Vango V85XXP pin configuration node
  include: [pinctrl-device.yaml]
  child-binding:
    description: Vango V85XXP pin configuration group
    properties:
      pinmux:
        required: true
        type: array
      bias-pull-up:
        type: boolean
      bias-pull-down:
        type: boolean
```

## soc/v85xxp/dts/bindings/pmu/v85xxp,pmu.yaml
```yaml
# Copyright (c) 2026 Vango Technologies
# SPDX-License-Identifier: Apache-2.0

description: V85XXP Power Management Unit (PMU)

compatible: "v85xxp,pmu"

include: base.yaml

properties:
  reg:
    required: true

  interrupts:
    required: false

  clocks:
    required: false
```

## soc/v85xxp/dts/bindings/pwm/v85xxp,pwm.yaml
```yaml
description: V85XXP PWM controller

compatible: "v85xxp,pwm"

include:
  - name: pwm-controller.yaml
  - name: base.yaml

properties:
  reg:
    required: true

  interrupts:
    required: true

  "#pwm-cells":
    const: 3
```

## soc/v85xxp/dts/bindings/rtc/v85xxp,rtc.yaml
```yaml
description: V85XXP RTC

compatible: "v85xxp,rtc"

include:
  - name: rtc.yaml
  - name: base.yaml

properties:
  reg:
    required: true

  interrupts:
    required: true
```

## soc/v85xxp/dts/bindings/serial/v85xxp,uart.yaml
```yaml
description: V85XXP UART

compatible: "v85xxp,uart"

include:
  - name: uart-controller.yaml
  - name: base.yaml

properties:
  reg:
    required: true

  interrupts:
    required: true

  current-speed:
    type: int
    default: 115200
```

## soc/v85xxp/dts/bindings/serial/vango,v85xxp-uart.yaml
```yaml
description: Vango V85XXP UART
compatible: "v85xxp,uart"
include: [uart-controller.yaml, pinctrl-device.yaml, base.yaml]
properties:
    reg:
      required: true
    interrupts:
      required: true
    clocks:
      required: true
```

## soc/v85xxp/dts/bindings/serial/vango,v85xxp-uart32k.yaml
```yaml
description: Vango V85XXP UART32K controller

compatible: "v85xxp,uart32k"

include: uart-controller.yaml

properties:
    reg:
      required: true
    interrupts:
      required: true
    clocks:
      required: true
```

## soc/v85xxp/dts/bindings/spi/v85xxp,spi.yaml
```yaml
description: V85XXP SPI controller

compatible: "v85xxp,spi"

include:
  - name: spi-controller.yaml
  - name: base.yaml

properties:
  reg:
    required: true

  interrupts:
    required: true
```

## soc/v85xxp/dts/bindings/watchdog/v85xxp,wdt.yaml
```yaml
description: V85XXP watchdog

compatible: "v85xxp,wdt"

include: base.yaml

properties:
  reg:
    required: true

  interrupts:
    required: true
```

## soc/v85xxp/soc/arm/v85xxp/Kconfig.defconfig
```kconfig
# Copyright (c) 2026 Vango Technologies
# SPDX-License-Identifier: Apache-2.0

if SOC_SERIES_V85XXP

config SOC_SERIES
	default "v85xxp"

config SOC
	default "v85xxp" if SOC_V85XXP

config NUM_IRQS
	default 29

config SYS_CLOCK_HW_CYCLES_PER_SEC
	default 6553600

endif # SOC_SERIES_V85XXP
```

## soc/v85xxp/soc/arm/v85xxp/Kconfig.soc
```kconfig
config SOC_SERIES_V85XXP
	bool
	select SOC_FAMILY_ARM
	help
	  Enable support for the V85XXP Cortex-M0 SoC series.

config SOC_FAMILY_V85XXP
	bool
	select HAS_V85XXP_HAL

config SOC_V85XXP
	bool
	select SOC_SERIES_V85XXP
	select ARM
	select CPU_CORTEX_M0
	select CPU_CORTEX_M_HAS_SYSTICK
	select HAS_CMSIS_CORE
	select CLOCK_CONTROL_V85XXP
	select PINCTRL_V85XXP
	select V85XXP_GPIO
	select V85XXP_UART
	help
	  V85XXP Cortex-M0 SoC.

config SOC_SERIES
	default "v85xxp" if SOC_SERIES_V85XXP

config SOC
	default "v85xxp" if SOC_V85XXP
```

## soc/v85xxp/zephyr/Kconfig
```kconfig
# Copyright (c) 2026 Vango Technologies
# SPDX-License-Identifier: Apache-2.0

source "$(ZEPHYR_V85XXP_SOC_MODULE_DIR)/Kconfig"
```
