/dts-v1/;
#include <arm/rn8xxx/rn8318.dtsi>

/ {
    model = "RN8xxx Development Board";
    compatible = "vendor,rn8xxx-board";

    chosen {
        zephyr,sram = &sram0;
        zephyr,flash = &flash0;
        zephyr,console = &uart0;
        zephyr,shell-uart = &uart0;
    };
};
