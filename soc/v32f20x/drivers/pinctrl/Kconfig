## soc/v32f20x/drivers/pinctrl/Kconfig
```kconfig
config PINCTRL_V32F20X
    bool "V32F20X Pinctrl Driver"
    default y
    depends on DT_HAS_VANGO_V32F20X_PINCTRL_ENABLED
    select PINCTRL
    select VANGO_V32F20X_HAL_GPIO
    help
      Enable driver for Vango V32F20X pin multiplexing and 
      configuration (Pinctrl).
```

## soc/v32f20x/drivers/pwm/Kconfig
```kconfig
config PWM_V32F20X
    bool "V32F20X PWM Driver"
    default y
    depends on DT_HAS_VANGO_V32F20X_TIMER_ENABLED
    select PWM
    select VANGO_V32F20X_HAL_TIMER
    help
      Enable support for Vango V32F20X PWM.
```

## soc/v32f20x/drivers/reset/Kconfig
```kconfig
# Vango V32F20X Reset configuration options

config RESET_V32F20X
	bool "Vango V32F20X Reset controller driver"
	default y
	depends on DT_HAS_VANGO_V32F20X_RESET_ENABLED
	select VANGO_V32F20X_HAL_SYSCFG
	help
	  Enable the Vango V32F20X Reset controller driver.
```

## soc/v32f20x/drivers/spi/Kconfig
```kconfig
config SPI_V32F20X
    bool "V32F20X SPI Driver"
    default y
    depends on DT_HAS_VANGO_V32F20X_SPI_ENABLED
    select SPI
    select VANGO_V32F20X_HAL_SPI
    help
      Enable support for Vango V32F20X SPI.
```

## soc/v32f20x/drivers/timer/Kconfig
```kconfig
# Vango V32F20X Timer/Counter configuration options

config COUNTER_V32F20X
	bool "Vango V32F20X Timer/Counter driver"
	default y
	depends on DT_HAS_VANGO_V32F20X_TIMER_ENABLED
	select COUNTER
	help
	  Enable the Vango V32F20X Timer/Counter driver.
```

## soc/v32f20x/drivers/watchdog/Kconfig
```kconfig
config WDT_V32F20X
    bool "V32F20X Watchdog Driver"
    default y
    depends on DT_HAS_VANGO_V32F20X_WDT_ENABLED
    select WATCHDOG
    select VANGO_V32F20X_HAL_WDT
    help
      Enable support for Vango V32F20X Watchdog.
```

## soc/v32f20x/dts/bindings/vango,v32f20x-ana-cmp.yaml
```yaml
# Copyright (c) 2024 Vango Technologies
# SPDX-License-Identifier: Apache-2.0

description: Vango Technologies V32F20X Analog Comparator

compatible: "vango,v32f20x-ana-cmp"

include: [base.yaml]

properties:
    reg:
      required: true
    interrupts:
      required: true

# This is used for wake-up logic in production
```

## soc/v32f20x/dts/bindings/vango,v32f20x-can.yaml
```yaml
# Copyright (c) 2024 Vango Technologies
# SPDX-License-Identifier: Apache-2.0

description: Vango Technologies V32F20X CAN Controller

compatible: "vango,v32f20x-can"

include: [can-controller.yaml, pinctrl-device.yaml]

properties:
  reg:
    required: true
  interrupts:
    required: true
  clocks:
    type: phandle-array
    required: true
  resets:
    type: phandle-array
    required: true
  bus-speed:
    type: int
```

## soc/v32f20x/dts/bindings/vango,v32f20x-clock.yaml
```yaml
description: Vango Technologies V32F20x Clock Controller

compatible: "vango,v32f20x-clock"

include: [base.yaml, clock-controller.yaml]

properties:
  "#clock-cells":
    const: 1

clock-cells:
  - id
```

## soc/v32f20x/dts/bindings/vango,v32f20x-crypto.yaml
```yaml
# Copyright (c) 2024 Vango Technologies
# SPDX-License-Identifier: Apache-2.0

description: Vango Technologies V32F20X Crypto Acceleration Engine

compatible: "vango,v32f20x-crypto"

properties:
  reg:
    type: array
    type: array
    required: true
    description: Memory address and size of crypto engine

  interrupts:
    type: array
    type: array
    description: Optional crypto interrupt for completion notification

  clocks:
    type: phandle-array
    required: true
    description: Clock source for crypto peripheral

  resets:
    type: phandle-array
    required: true
    description: Reset control for crypto peripheral

  dmas:
    type: phandle-array
    description: Optional DMA channels for crypto operations

  dma-names:
    type: string-array
    description: Names of DMA channels ("in", "out")

  supports-aes:
    type: boolean
    description: Support for AES encryption

  aes-modes:
    type: string-array
    default: ["ecb", "cbc", "ctr", "ofb", "cfb"]
    description: Supported AES modes

  aes-key-sizes:
    type: array
    default: [128, 192, 256]
    description: Supported AES key sizes in bits

  supports-des:
    type: boolean
    description: Support for DES/3DES encryption

  supports-hash:
    type: boolean
    description: Support for hash functions

  hash-algorithms:
    type: string-array
    default: ["sha1", "sha256", "sha384", "sha512", "md5"]
    description: Supported hash algorithms

  supports-hmac:
    type: boolean
    description: Support for HMAC operations

  supports-rsa:
    type: boolean
    description: Support for RSA operations

  supports-ecc:
    type: boolean
    description: Support for ECC operations

  max-sessions:
    type: int
    default: 4
    description: Maximum concurrent crypto sessions

  supports-high-speed:
    type: boolean
    description: Support for high-speed operation

  max-throughput-mbps:
    type: int
    description: Maximum crypto throughput in Mbps
```

## soc/v32f20x/dts/bindings/vango,v32f20x-dac.yaml
```yaml
# Copyright (c) 2024 Vango Technologies
# SPDX-License-Identifier: Apache-2.0

description: Vango Technologies V32F20X DAC Controller

compatible: "vango,v32f20x-dac"

include: [dac-controller.yaml, pinctrl-device.yaml]

properties:
  reg:
    type: array
    type: array
    required: true
    description: Memory address and size of DAC controller

  interrupts:
    type: array
    type: array
    description: Optional DAC interrupt

  clocks:
    type: phandle-array
    required: true
    description: Clock source for DAC peripheral

  resets:
    type: phandle-array
    required: true
    description: Reset control for DAC peripheral

  num-channels:
    type: int
    required: true
    description: Number of DAC output channels

  resolution:
    type: int
    default: 12
    description: DAC resolution in bits
```

## soc/v32f20x/dts/bindings/vango,v32f20x-gpio.yaml
```yaml
# Copyright (c) 2024 Vango Technologies
# SPDX-License-Identifier: Apache-2.0

description: Vango Technologies V32F20X GPIO Controller

compatible: "vango,v32f20x-gpio"

include: [gpio-controller.yaml, base.yaml]

properties:
  reg:
    type: array
    required: true
  interrupts:
    type: array
    required: false
  clocks:
    type: phandle-array
    required: false
  resets:
    type: phandle-array
    required: false
  ngpios:
    type: int
    required: true
  "#gpio-cells":
    type: int
    const: 2

gpio-cells:
  - pin
  - flags
```

## soc/v32f20x/dts/bindings/vango,v32f20x-i2s.yaml
```yaml
# Copyright (c) 2024 Vango Technologies
# SPDX-License-Identifier: Apache-2.0

description: Vango Technologies V32F20X I2S Controller
compatible: "vango,v32f20x-i2s"
include: [i2s-controller.yaml, pinctrl-device.yaml]
properties:
  reg:
    required: true
  interrupts:
    required: true
  clocks:
    type: phandle-array
    required: true
  resets:
    type: phandle-array
    required: true
```

## soc/v32f20x/dts/bindings/vango,v32f20x-mailbox.yaml
```yaml
# Copyright (c) 2024 Vango Technologies
# SPDX-License-Identifier: Apache-2.0

description: Vango Technologies V32F20X Mailbox (IPC)

compatible: "vango,v32f20x-mailbox"

include: [base.yaml]

properties:
  reg:
    required: true
  interrupts:
    required: true
```

## soc/v32f20x/dts/bindings/vango,v32f20x-mbox.yaml
```yaml
# Copyright (c) 2024 Vango Technologies
# SPDX-License-Identifier: Apache-2.0

description: Vango V32F20x Mailbox Controller

compatible: "vango,v32f20x-mbox"

include: [base.yaml, mailbox-controller.yaml]

properties:
    interrupts:
      required: true
    "#mbox-cells":
      const: 1

mbox-cells:
  - channel
```

## soc/v32f20x/dts/bindings/vango,v32f20x-modbus.yaml
```yaml
# Copyright (c) 2024 Vango Technologies
# SPDX-License-Identifier: Apache-2.0

description: Vango Technologies Modbus Serial Node

compatible: "vango,v32f20x-modbus"

include: ["zephyr,modbus-serial.yaml"]
```

## soc/v32f20x/dts/bindings/vango,v32f20x-ospi.yaml
```yaml
# Copyright (c) 2024 Vango Technologies
# SPDX-License-Identifier: Apache-2.0

description: Vango Technologies V32F20X OSPI Controller
compatible: "vango,v32f20x-ospi"
include: [spi-controller.yaml, pinctrl-device.yaml]
properties:
  reg:
    required: true
  interrupts:
    required: true
  clocks:
    type: phandle-array
    required: true
  resets:
    type: phandle-array
    required: true
```

## soc/v32f20x/dts/bindings/vango,v32f20x-pinctrl.yaml
```yaml
# Copyright (c) 2024 Vango Technologies
# SPDX-License-Identifier: Apache-2.0

description: Vango Technologies V32F20X Pinctrl
compatible: "vango,v32f20x-pinctrl"
include: [base.yaml]
properties:
  reg:
    type: array
    required: true

child-binding:
  description: Vango Technologies V32F20X pin configuration node
  include: [pinctrl-device.yaml]
  child-binding:
    description: Vango Technologies V32F20X pin configuration group
    properties:
      pinmux:
        required: true
        type: array
      bias-pull-up:
        type: boolean
      bias-pull-down:
        type: boolean
      drive-open-drain:
        type: boolean
```

## soc/v32f20x/dts/bindings/vango,v32f20x-reset.yaml
```yaml
description: Vango Technologies V32F20x Reset Controller

compatible: "vango,v32f20x-reset"

include: [base.yaml, reset-controller.yaml]

properties:
  "#reset-cells":
    const: 1

reset-cells:
  - id
```

## soc/v32f20x/dts/bindings/vango,v32f20x-timer.yaml
```yaml
# Copyright (c) 2024 Vango Technologies
# SPDX-License-Identifier: Apache-2.0

description: Vango Technologies V32F20X Timer
compatible: "vango,v32f20x-timer"
include: [base.yaml, pinctrl-device.yaml]
properties:
  reg:
    type: array
    required: true
  interrupts:
    type: array
    required: true
  clocks:
    type: phandle-array
    required: true
  resets:
    type: phandle-array
    required: true
```

## soc/v32f20x/dts/bindings/vango,v32f20x-uart.yaml
```yaml
# Copyright (c) 2024 Vango Technologies
# SPDX-License-Identifier: Apache-2.0

description: Vango Technologies V32F20X UART

compatible: "vango,v32f20x-uart"

include: [uart-controller.yaml, pinctrl-device.yaml, base.yaml]

properties:
  reg:
    required: false
  interrupts:
    required: false
  clocks:
    type: phandle-array
    required: false
  resets:
    type: phandle-array
    required: false
```

## soc/v32f20x/dts/bindings/vango,v32f20x-watchdog.yaml
```yaml
# Copyright (c) 2024 Vango Technologies
# SPDX-License-Identifier: Apache-2.0

description: Vango Technologies V32F20X Watchdog
compatible: "vango,v32f20x-watchdog"
include: [base.yaml]
properties:
  reg:
    type: array
    required: true
  clocks:
    type: phandle-array
    required: true
  resets:
    type: phandle-array
    required: true
```

## soc/v32f20x/soc/Kconfig
```kconfig
# Source the SoC definition
source "$(ZEPHYR_V32F20X_SOC_MODULE_DIR)/soc/vango/v32f20x/Kconfig.soc"
```
