## soc/v32f20x/soc/vango/v32f20x/Kconfig.defconfig
```kconfig
# Copyright (c) 2024 Vango Technologies
# SPDX-License-Identifier: Apache-2.0

if SOC_SERIES_V32F20X

config SOC_SERIES
	default "v32f20x"

config SOC
	default "v32f20x"

config SOC_V32F20X_CPUMETER
	default y if !SOC_V32F20X_CPUAPP

config SYS_CLOCK_HW_CYCLES_PER_SEC
	default 160000000

config NUM_IRQS
	default 128

config CLOCK_CONTROL_INIT_PRIORITY
	default 40

config RESET_INIT_PRIORITY
	default 40

config GPIO_INIT_PRIORITY
	default 40

if SOC_V32F20X_CPUAPP # M33
config ARM_MPU
	default y
config FPU
	default y
endif

endif # SOC_SERIES_V32F20X
```

## soc/v32f20x/soc/vango/v32f20x/Kconfig.soc
```kconfig
# Copyright (c) 2024 Vango Technologies
# SPDX-License-Identifier: Apache-2.0

config SOC_V32F20X_CPU0
	bool "V32F20X Cortex-M0 Core"
	select ARM
	select CPU_CORTEX_M0
	select SOC_FAMILY_VANGO
	select CPU_CORTEX_M_HAS_SYSTICK
	select CORTEX_M_SYSTICK
	select HAS_V32F20X_HAL
	select CLOCK_CONTROL_V32F20X
	select PINCTRL_V32F20X
	select V32F20X_GPIO
	select V32F20X_UART

config SOC_V32F20X_CPU1
	bool "V32F20X Cortex-M33 Core"
	select ARM
	select CPU_CORTEX_M33
	select CPU_HAS_ARM_MPU
	select CPU_HAS_FPU
	select ARMV8_M_DSP
	select SOC_FAMILY_VANGO
	select CPU_CORTEX_M_HAS_SYSTICK
	select CORTEX_M_SYSTICK
	select HAS_V32F20X_HAL
	select CLOCK_CONTROL_V32F20X
	select PINCTRL_V32F20X
	select V32F20X_GPIO
	select V32F20X_UART

config SOC_SERIES_V32F20X
	bool
	default y if SOC_V32F20X_CPU0 || SOC_V32F20X_CPU1
	select SOC_FAMILY_VANGO
	select HAS_V32F20X_HAL
```

## soc/v32f20x/soc/vango/v32f20x/Kconfig.v32f20x
```kconfig
# Copyright (c) 2024 Vango Technologies
# SPDX-License-Identifier: Apache-2.0

source "$(ZEPHYR_V32F20X_SOC_MODULE_DIR)/soc/vango/v32f20x/Kconfig.soc"

config SOC_FAMILY
    string
    default "vango" if SOC_FAMILY_VANGO

config SOC_SERIES
    string
    default "v32f20x" if SOC_SERIES_V32F20X

config SOC
    string
    default "v32f20x" if SOC_SERIES_V32F20X

# 1. Register HAL capability
config HAS_V32F20X_HAL
    bool
    default y
    depends on SOC_SERIES_V32F20X

# 2. Select HAL Component Symbols
if SOC_SERIES_V32F20X

config VANGO_V32F20X_HAL_ADC
    bool
    default y if ADC
config VANGO_V32F20X_HAL_CAN
    bool
    default y if CAN
config VANGO_V32F20X_HAL_CLK
    bool
    default y
config VANGO_V32F20X_HAL_CRC
    bool
    default y
config VANGO_V32F20X_HAL_CRYPT
    bool
    default y
config VANGO_V32F20X_HAL_DAC
    bool
    default y
config VANGO_V32F20X_HAL_GPIO
    bool
    default y
config VANGO_V32F20X_HAL_I2C
    bool
    default y if I2C
config VANGO_V32F20X_HAL_UART
    bool
    default y if SERIAL
config VANGO_V32F20X_HAL_SPI
    bool
    default y if SPI
config VANGO_V32F20X_HAL_SYSCFG
    bool
    default y
config VANGO_V32F20X_HAL_TIMER
    bool
    default y
config VANGO_V32F20X_HAL_WDT
    bool
    default y if WATCHDOG
config VANGO_V32F20X_HAL_MAILBOX
    bool
    default y if MBOX_V32F20X
config VANGO_V32F20X_HAL_MISC
    bool
    default y

endif
```

## soc/v32f20x/zephyr/Kconfig
```kconfig
# Copyright (c) 2024 Vango Technologies
# SPDX-License-Identifier: Apache-2.0

source "$(ZEPHYR_V32F20X_SOC_MODULE_DIR)/Kconfig"
```

## soc/v85xxp/Kconfig
```kconfig
# V85XXP Drivers Kconfig - single source of truth
# Each driver selects its corresponding HAL library module

menu "V85XXP Drivers"
	depends on SOC_SERIES_V85XXP

# Foundation Infrastructure
rsource "drivers/clock_control/Kconfig"
rsource "drivers/pinctrl/Kconfig"
rsource "drivers/dma/Kconfig"

# IO & Bus
config V85XXP_GPIO
	bool "V85XXP GPIO Driver"
	default y
	depends on DT_HAS_V85XXP_GPIO_ENABLED
	select GPIO
	select VANGO_V85XXP_HAL_GPIO
	help
	  Enable support for Vango V85XXP GPIO controller.

config V85XXP_UART
	bool "V85XXP UART Driver"
	default y
	depends on DT_HAS_V85XXP_UART_ENABLED
	select SERIAL_HAS_DRIVER
	select SERIAL_SUPPORT_INTERRUPT
	select VANGO_V85XXP_HAL_UART
	help
	  Enable support for Vango V85XXP UART.

config I2C_V85XXP
	bool "V85XXP I2C Driver"
	default y
	depends on DT_HAS_V85XXP_I2C_ENABLED
	select I2C
	select VANGO_V85XXP_HAL_I2C
	help
	  Enable support for Vango V85XXP I2C.

config SPI_V85XXP
	bool "V85XXP SPI Driver"
	default y
	depends on DT_HAS_V85XXP_SPI_ENABLED
	select SPI
	select VANGO_V85XXP_HAL_SPI
	help
	  Enable support for Vango V85XXP SPI.

config V85XXP_ISO7816
	bool "V85XXP ISO7816 Driver"
	default y
	depends on DT_HAS_V85XXP_ISO7816_ENABLED
	select VANGO_V85XXP_HAL_ISO7816
	help
	  Enable support for Vango V85XXP ISO7816.

# Analog & Timers
config ADC_V85XXP
	bool "V85XXP ADC Driver"
	default y
	depends on DT_HAS_V85XXP_ADC_ENABLED
	select ADC
	select VANGO_V85XXP_HAL_ADC
	select VANGO_V85XXP_HAL_RTC
	help
	  Enable support for Vango V85XXP ADC.

config PWM_V85XXP
	bool "V85XXP PWM Driver"
	default y
	depends on DT_HAS_V85XXP_PWM_ENABLED
	select PWM
	select VANGO_V85XXP_HAL_PWM
	help
	  Enable support for Vango V85XXP PWM.

config COUNTER_V85XXP_TMR
	bool "V85XXP Timer Counter Driver"
	default y
	depends on DT_HAS_V85XXP_TMR_COUNTER_ENABLED
	select COUNTER
	select VANGO_V85XXP_HAL_TMR
	help
	  Enable support for Vango V85XXP TMR as counter device.

config RTC_V85XXP
	bool "V85XXP RTC Driver"
	default y
	depends on DT_HAS_V85XXP_RTC_ENABLED
	select RTC
	select VANGO_V85XXP_HAL_RTC
	help
	  Enable support for Vango V85XXP RTC.

rsource "drivers/watchdog/Kconfig"
rsource "drivers/flash/Kconfig"
rsource "drivers/analog/Kconfig"

# System & Graphics
config CRYPT_V85XXP
	bool "V85XXP Crypt Driver"
	default y
	depends on DT_HAS_V85XXP_CRYPT_ENABLED
	select VANGO_V85XXP_HAL_CRYPT
	help
	  Enable support for Vango V85XXP hardware crypto.

config LCD_V85XXP
	bool "V85XXP LCD Segment Driver"
	default y
	depends on DT_HAS_V85XXP_LCD_ENABLED
	select VANGO_V85XXP_HAL_LCD
	help
	  Enable support for Vango V85XXP segment LCD controller.

config PMU_V85XXP
	bool "V85XXP PMU Driver"
	default y
	depends on DT_HAS_V85XXP_PMU_ENABLED
	select VANGO_V85XXP_HAL_PMU
	help
	  Enable support for Vango V85XXP Power Management Unit.

endmenu
```

## soc/v85xxp/boards/v85xxp_board/Kconfig.defconfig
```kconfig
# Copyright (c) 2026 Vango Technologies
# SPDX-License-Identifier: Apache-2.0

if BOARD_V85XXP_BOARD

config BOARD
	default "v85xxp_board"

# Critical: Ensure the SOC Series is selected to trigger linker script discovery
config SOC_SERIES_V85XXP
	default y

config SOC_V85XXP
	default y

endif # BOARD_V85XXP_BOARD
```

## soc/v85xxp/boards/v85xxp_board/board.yml
```yaml
board:
  name: v85xxp_board
  full_name: V85XXP Development Board
  vendor: custom
  socs:
    - name: v85xxp
```

## soc/v85xxp/boards/v85xxp_board/v85xxp_board_defconfig
```kconfig
CONFIG_SERIAL=y
CONFIG_CONSOLE=y
CONFIG_UART_CONSOLE=y
CONFIG_UART_USE_RUNTIME_CONFIGURE=y
CONFIG_PRINTK=y

# 系统时钟配置 (SysTick)
CONFIG_SYS_CLOCK_HW_CYCLES_PER_SEC=6553600
CONFIG_CORTEX_M_SYSTICK=y
```

## soc/v85xxp/drivers/Kconfig
```kconfig
# Professional Drivers Kconfig for V85XXP
# Using strict rsource for hierarchical isolation

menu "V85XXP Drivers"
    depends on SOC_SERIES_V85XXP

# 1. Foundation Infrastructure (Strict relative inclusion)
rsource "clock_control/Kconfig"
rsource "pinctrl/Kconfig"
rsource "dma/Kconfig"

# 2. IO & Bus Drivers
config V85XXP_GPIO
    bool "V85XXP GPIO Driver"
    default y
    depends on DT_HAS_V85XXP_GPIO_ENABLED
    select GPIO
    help
      Enable support for Vango V85XXP GPIO controller.

config V85XXP_UART
    bool "V85XXP UART Driver"
    default y
    depends on DT_HAS_V85XXP_UART_ENABLED
    select SERIAL_HAS_DRIVER
    select SERIAL_SUPPORT_INTERRUPT
    help
      Enable support for Vango V85XXP UART.

config I2C_V85XXP
    bool "V85XXP I2C Driver"
    default y
    depends on DT_HAS_V85XXP_I2C_ENABLED
    select I2C
    help
      Enable support for Vango V85XXP I2C.

config SPI_V85XXP
    bool "V85XXP SPI Driver"
    default y
    depends on DT_HAS_V85XXP_SPI_ENABLED
    select SPI
    help
      Enable support for Vango V85XXP SPI.

# 3. Analog & Timers
config ADC_V85XXP
    bool "V85XXP ADC Driver"
    default y
    depends on DT_HAS_V85XXP_ADC_ENABLED
    select ADC
    help
      Enable support for Vango V85XXP ADC.

config PWM_V85XXP
    bool "V85XXP PWM Driver"
    default y
    depends on DT_HAS_V85XXP_PWM_ENABLED
    select PWM
    help
      Enable support for Vango V85XXP PWM.

rsource "watchdog/Kconfig"
rsource "flash/Kconfig"
rsource "analog/Kconfig"

endmenu
```

## soc/v85xxp/drivers/adc/Kconfig
```kconfig
config ADC_V85XXP
	bool "V85XXP ADC driver"
	default y
	depends on ADC
	depends on DT_HAS_V85XXP_ADC_ENABLED
	help
	  Enable ADC driver for V85XXP ANA ADC block.
```

## soc/v85xxp/drivers/analog/Kconfig
```kconfig
config ANALOG_V85XXP
	bool "V85XXP Analog Misc Driver"
	default y
	depends on DT_HAS_V85XXP_ANALOG_ENABLED
	select VANGO_V85XXP_HAL_ANA
	help
	  Enable support for Vango V85XXP Analog mixed signal blocks.
```

## soc/v85xxp/drivers/clock_control/Kconfig
```kconfig
config CLOCK_CONTROL_V85XXP
	bool "V85XXP Clock Control Driver"
	default y
	depends on DT_HAS_V85XXP_CLOCK_ENABLED
	select CLOCK_CONTROL
	select VANGO_V85XXP_HAL_CLK
	help
	  Enable driver for Vango V85XXP clock controller.
```

## soc/v85xxp/drivers/counter/Kconfig
```kconfig
config COUNTER_V85XXP_TMR
	bool "V85XXP timer counter driver"
	default y
	depends on COUNTER
	depends on DT_HAS_V85XXP_TMR_COUNTER_ENABLED
	help
	  Enable counter driver based on V85XXP TMR0..TMR3.
```

## soc/v85xxp/drivers/dma/Kconfig
```kconfig
config DMA_V85XXP
    bool "V85XXP DMA Driver"
    default y
    depends on DT_HAS_V85XXP_DMA_ENABLED
    select DMA
    help
      Enable support for Vango V85XXP DMA controller.
```

## soc/v85xxp/drivers/flash/Kconfig
```kconfig
config FLASH_V85XXP
    bool "V85XXP Internal Flash Driver"
    default y
    depends on DT_HAS_V85XXP_FLASH_CONTROLLER_ENABLED
    select FLASH_HAS_DRIVER_ENABLED
    select FLASH_HAS_PAGE_LAYOUT
    help
      Enable support for Vango V85XXP internal flash.

config FLASH_INIT_PRIORITY
    int "Flash init priority"
    default 50
    depends on FLASH_V85XXP
    help
      Initialization priority for the V85XXP internal flash driver.
```

## soc/v85xxp/drivers/gpio/Kconfig
```kconfig
config GPIO_V85XXP
	bool "V85XXP GPIO driver"
	default y
	depends on GPIO
	depends on DT_HAS_V85XXP_GPIO_ENABLED
	select GPIO_GET_CONFIG
	help
	  Enable GPIO driver for V85XXP GPIOB..GPIOF ports.
```

## soc/v85xxp/drivers/i2c/Kconfig
```kconfig
config I2C_V85XXP
	bool "V85XXP I2C driver"
	default y
	depends on I2C
	depends on DT_HAS_V85XXP_I2C_ENABLED
	help
	  Enable I2C driver for V85XXP.
```

## soc/v85xxp/drivers/pinctrl/Kconfig
```kconfig
config PINCTRL_V85XXP
	bool "V85XXP Pinctrl Driver"
	default y
	depends on DT_HAS_V85XXP_PINCTRL_ENABLED
	select PINCTRL
	select VANGO_V85XXP_HAL_GPIO
	help
	  Enable driver for Vango V85XXP pin configuration.
```

## soc/v85xxp/drivers/pwm/Kconfig
```kconfig
config PWM_V85XXP
	bool "V85XXP PWM driver"
	default y
	depends on PWM
	depends on DT_HAS_V85XXP_PWM_ENABLED
	help
	  Enable PWM driver for V85XXP PWM0..PWM3 blocks.
```

## soc/v85xxp/drivers/rtc/Kconfig
```kconfig
config RTC_V85XXP
	bool "V85XXP RTC driver"
	default y
	depends on RTC
	depends on DT_HAS_V85XXP_RTC_ENABLED
	help
	  Enable RTC driver for V85XXP.
```

## soc/v85xxp/drivers/serial/Kconfig
```kconfig
config SERIAL_V85XXP
	bool "V85XXP UART driver"
	default y
	depends on SERIAL
	depends on DT_HAS_V85XXP_UART_ENABLED
	select SERIAL_HAS_DRIVER
	help
	  Enable the polling UART driver for the V85XXP UART block.
```

## soc/v85xxp/drivers/spi/Kconfig
```kconfig
config SPI_V85XXP
	bool "V85XXP SPI driver"
	default y
	depends on SPI
	depends on DT_HAS_V85XXP_SPI_ENABLED
	help
	  Enable SPI master driver for V85XXP.
```

## soc/v85xxp/drivers/watchdog/Kconfig
```kconfig
config WDT_V85XXP
    bool "V85XXP Watchdog Driver"
    default y
    depends on DT_HAS_V85XXP_WDT_ENABLED
    select WATCHDOG
    help
      Enable support for Vango V85XXP Watchdog.
```

## soc/v85xxp/dts/bindings/adc/v85xxp,adc.yaml
```yaml
description: V85XXP ADC controller

compatible: "v85xxp,adc"

include:
  - name: adc-controller.yaml
  - name: base.yaml

properties:
  reg:
    required: true

  interrupts:
    required: true

  "#io-channel-cells":
    const: 1
```
