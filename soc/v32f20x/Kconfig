## soc/v32f20x/Kconfig
```kconfig
# Copyright (c) 2024 Vango Technologies
# SPDX-License-Identifier: Apache-2.0

# Load master drivers Kconfig
rsource "drivers/Kconfig"

config TFM_BOARD
	string "TF-M Board Platform Path"
```

## soc/v32f20x/boards/vango/v32f20x_board/Kconfig.defconfig
```kconfig
if BOARD_V32F20X_BOARD

config BOARD
	default "v32f20x_board"

config SOC
	default "v32f20x"



config TFM_BOARD
        default "vango_v32f20x_cpuapp"


endif # BOARD_V32F20X_BOARD
```

## soc/v32f20x/drivers/entropy/Kconfig
```kconfig
# Vango V32F20X Entropy configuration options

config ENTROPY_V32F20X
	bool "Vango V32F20X Entropy driver"
	default y
	depends on DT_HAS_VANGO_V32F20X_RNG_ENABLED && ENTROPY_GENERATOR
	select ENTROPY_HAS_DRIVER
        select VANGO_V32F20X_HAL_RNG
	help
	  Enable the Vango V32F20X Entropy driver.
```

## soc/v32f20x/dts/bindings/vango,v32f20x-adc.yaml
```yaml
# Copyright (c) 2024 Vango Technologies
# SPDX-License-Identifier: Apache-2.0

description: Vango Technologies V32F20X ADC

compatible: "vango,v32f20x-adc"

include: [adc-controller.yaml, pinctrl-device.yaml, base.yaml]

properties:
  reg:
    type: array
    required: true
  interrupts:
    type: array
    required: true
  clocks:
    type: phandle-array
    required: true
  resets:
    type: phandle-array
    required: false
  "#io-channel-cells":
    const: 1

io-channel-cells:
  - input
```

## soc/v32f20x/dts/bindings/vango,v32f20x-dma.yaml
```yaml
# Copyright (c) 2024 Vango Technologies
# SPDX-License-Identifier: Apache-2.0

description: Vango Technologies V32F20X DMA Controller

compatible: "vango,v32f20x-dma"

include: [dma-controller.yaml, base.yaml]

properties:
  reg:
    type: array
    required: true
  interrupts:
    type: array
    required: true
  clocks:
    type: phandle-array
    required: true
  resets:
    type: phandle-array
    required: false
  "#dma-cells":
    const: 2

dma-cells:
  - channel
  - slot
```

## soc/v32f20x/dts/bindings/vango,v32f20x-flash-controller.yaml
```yaml
# Copyright (c) 2024 Vango Technologies
# SPDX-License-Identifier: Apache-2.0

description: Vango V32F20X Flash Controller

compatible: "vango,v32f20x-flash-controller"

include: [base.yaml]

properties:
    reg:
      required: true
    erase-block-size:
      type: int
      required: true
    write-block-size:
      type: int
      required: true
```

## soc/v32f20x/dts/bindings/vango,v32f20x-rng.yaml
```yaml
# Copyright (c) 2024 Vango Technologies
# SPDX-License-Identifier: Apache-2.0

description: Vango Technologies V32F20X RNG

compatible: "vango,v32f20x-rng"

include: base.yaml

properties:
  reg:
    type: array
    description: MMIO register space for the RNG.
    required: true
  clocks:
    type: phandle-array
    required: false
  resets:
    type: phandle-array
    required: false
```

## soc/v32f20x/dts/bindings/watchdog/vango,v32f20x-wdt.yaml
```yaml
description: Vango V32F20X Watchdog Timer

compatible: "vango,v32f20x-wdt"

include: base.yaml

properties:
  reg:
    required: true

  clocks:
    type: phandle-array
    required: true

  resets:
    type: phandle-array
    required: true
```
