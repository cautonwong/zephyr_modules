# V32F20x_CM33 register map
File version: 1.0.3
CPU: CM33 r0p4, little endian, MPU, FPU, DSP, 3 interrupt priority bits, 8 SAU regions
Registers are 32-bit, read-write, reset 0x0 unless marked. A register's access mark holds for its fields unless they carry their own. Offsets are from the block's base; lines under a group give offsets from that group; [hi:lo] are bit positions; {n}, {i} and the like mark numbered series; 'fields as' and 'values as' point back to an identical list; <NAME> marks a mode.

## Memory map
0x20201000 DMA0 size 0x800 — DMA0 Peripheral Interface
0x20201800 DMA1 size 0x800
0x20240000 USB_HS size 0x40000 — USB_HS Peripheral Interface
0x20280000 USB_FS size 0x40000 — USB_FS Peripheral Interface
0x20300000 CRC size 0x800 — CRC Peripheral Interface
0x21014000 WAVER size 0x1000 — WAVER Peripheral Interface
0x21015000 HFM size 0x1000 — HFM Peripheral Interface
0x21030000 SYSCFG1 size 0x800 — SYSCFG1 Peripheral Interface
0x30201000 SEC_DMA0 size 0x800
0x30201800 SEC_DMA1 size 0x800
0x30240000 SEC_USB_HS size 0x40000
0x30280000 SEC_USB_FS size 0x40000
0x30300000 SEC_CRC size 0x800
0x40010000 UART0 size 0x800 — UART0 Peripheral Interface
0x40010000 SPI0 size 0x800 — SPI0 Peripheral Interface
0x40010000 I2C0 size 0x800 — I2C0 Peripheral Interface
{0x40010000+0x800*n} UART{n} size 0x800 (n=1..13)
{0x40010000+0x800*n} SPI{n} size 0x800 (n=1..13)
{0x40010000+0x800*n} I2C{n} size 0x800 (n=1..13)
0x40040000 ISO78160 size 0x40 — ISO78160 Peripheral Interface
0x40040040 ISO78161 size 0x40
0x40050000 BTMR0 size 0x20 — BTMR0 Peripheral Interface
0x40050020 BTMR1 size 0x20
0x40050040 BTMR2 size 0x20
0x40050060 BTMR3 size 0x20
0x40050100 BPWM0 size 0x20 — BPWM0 Peripheral Interface
0x40050120 BPWM1 size 0x20
0x40050140 BPWM2 size 0x20
0x40050160 BPWM3 size 0x20
0x400501F0 BPWMMUX0 size 0x10 — BPWMMUX0 Peripheral Interface
0x40050800 ETMR0 size 0x800 — ETMR0 Peripheral Interface
0x40051000 ETMR1 size 0x800
0x40051800 GTMR0 size 0x800 — GTMR0 Peripheral Interface
0x40052000 GTMR1 size 0x800
0x40052800 GTMR2 size 0x800
0x40053000 GTMR3 size 0x800
0x40060000 RNG size 0x1000 — RNG Peripheral Interface
0x40070000 SCR size 0x1000 — SCR Peripheral Interface
0x40071000 FlashA_MPC size 0x1000 — FlashA_MPC Peripheral Interface
0x40072000 FlashB_MPC size 0x1000
0x40073000 SRAM0_MPC size 0x1000
0x40074000 SRAM1_MPC size 0x1000
0x40075000 SRAM2_MPC size 0x1000
0x40076000 SRAM3_MPC size 0x1000
0x40080000 CAN0 size 0x800 — CAN0 Peripheral Interface
0x40080800 CAN1 size 0x800
0x40083000 I2S0 size 0x800 — I2S0 Peripheral Interface
0x40083800 I2S1 size 0x800
0x40084000 SDIO0 size 0x2000 — SDIO0 Peripheral Interface
0x40086000 SDIO1 size 0x2000
0x40090000 WDT0 size 0x800 — WDT0 Peripheral Interface
0x40090800 WDT1 size 0x800
0x400A0000 DAC size 0x800 — DAC Peripheral Interface
0x400A0800 EADC size 0x800 — EADC Peripheral Interface
0x400A1000 ADC0 size 0x100 — ADC0 Peripheral Interface
0x400A1100 ADC1 size 0x100
0x40100000 RETRAM size 0x800 — RETRAM Peripheral Interface
0x40100800 PMU size 0x800 — PMU Peripheral Interface
0x40101800 COMP size 0x800 — COMP Peripheral Interface
0x40102000 SYSCFGLP size 0x800 — SYSCFGLP Peripheral Interface
0x40102800 RTCALM size 0x800 — RTCALM Peripheral Interface
0x40103000 RTC size 0x800 — RTC Peripheral Interface
0x40103800 RTCANA size 0x800 — RTCANA Peripheral Interface
0x40104000 GPIOA size 0x400 — GPIOA Peripheral Interface
0x40104400 GPIOB size 0x400
0x40104800 GPIOC size 0x400
0x40104C00 GPIOD size 0x400
0x40105000 GPIOE size 0x400
0x40105400 GPIOF size 0x400
0x40105800 GPIOG size 0x400
0x40105C00 GPIOH size 0x400
0x40106000 GPIOI size 0x400
0x40106400 IOCTRL size 0x400 — IOCTRL Peripheral Interface
0x40106800 EXTI size 0x800 — EXTI Peripheral Interface
0x40107000 VGIO size 0x400 — VGIO Peripheral Interface
0x40108000 LPBTMR0 size 0x20
0x40109000 LPBTMR1 size 0x20
0x40200000 SYSCFG0 size 0x800 — SYSCFG0 Peripheral Interface
0x40201000 DCMI size 0x800 — DCMI Peripheral Interface
0x40202000 ETH0 size 0x2000 — ETH0 Peripheral Interface
0x40204000 ETH1 size 0x2000
0x40206000 ENCENG size 0x800 — ENCENG Peripheral Interface
0x40208000 FLASHA size 0x4000 — FLASHA Peripheral Interface
0x4020C000 FLASHB size 0x4000
0x41010000 I2C14 size 0x800
0x41020000 BSPI0 size 0x800 — BSPI0 Peripheral Interface
0x41020800 BSPI1 size 0x800
0x41021000 BSPI2 size 0x800
0x41021800 BSPI3 size 0x800
0x41022000 BSPI4 size 0x800
0x41022800 BSPI5 size 0x800
0x41030000 UART14 size 0x800
0x41030800 UART15 size 0x800
0x41031000 UART16 size 0x800
0x41031800 UART17 size 0x800
0x41032000 UART18 size 0x800
0x41032800 UART19 size 0x800
0x41040000 ISO78162 size 0x40
0x41040040 ISO78163 size 0x40
0x41050000 BTMR4 size 0x20
0x41050020 BTMR5 size 0x20
0x41050040 BTMR6 size 0x20
0x41050060 BTMR7 size 0x20
0x41050100 BPWM4 size 0x20
0x41050120 BPWM5 size 0x20
0x41050140 BPWM6 size 0x20
0x41050160 BPWM7 size 0x20
0x410501F0 BPWMMUX1 size 0x10
0x41080800 BDMA size 0x800 — BDMA Peripheral Interface
0x41090000 WDT2 size 0x800
0x41208000 FLASH0 size 0x4000
{0x50010000+0x800*n} SEC_UART{n} size 0x800 (n=0..13)
{0x50010000+0x800*n} SEC_SPI{n} size 0x800 (n=0..13)
{0x50010000+0x800*n} SEC_I2C{n} size 0x800 (n=0..13)
0x50040000 SEC_ISO78160 size 0x40
0x50040040 SEC_ISO78161 size 0x40
0x50050000 SEC_BTMR0 size 0x20
0x50050020 SEC_BTMR1 size 0x20
0x50050040 SEC_BTMR2 size 0x20
0x50050060 SEC_BTMR3 size 0x20
0x50050100 SEC_BPWM0 size 0x20
0x50050120 SEC_BPWM1 size 0x20
0x50050140 SEC_BPWM2 size 0x20
0x50050160 SEC_BPWM3 size 0x20
0x500501F0 SEC_BPWMMUX0 size 0x10
0x50050800 SEC_ETMR0 size 0x800
0x50051000 SEC_ETMR1 size 0x800
0x50051800 SEC_GTMR0 size 0x800
0x50052000 SEC_GTMR1 size 0x800
0x50052800 SEC_GTMR2 size 0x800
0x50053000 SEC_GTMR3 size 0x800
0x50060000 SEC_RNG size 0x1000
0x50070000 SEC_SCR size 0x1000
0x50071000 SEC_FlashA_MPC size 0x1000
0x50072000 SEC_FlashB_MPC size 0x1000
0x50073000 SEC_SRAM0_MPC size 0x1000
0x50074000 SEC_SRAM1_MPC size 0x1000
0x50075000 SEC_SRAM2_MPC size 0x1000
0x50076000 SEC_SRAM3_MPC size 0x1000
0x50080000 SEC_CAN0 size 0x800
0x50080800 SEC_CAN1 size 0x800
0x50083000 SEC_I2S0 size 0x800
0x50083800 SEC_I2S1 size 0x800
0x50084000 SEC_SDIO0 size 0x2000
0x50086000 SEC_SDIO1 size 0x2000
0x50090000 SEC_WDT0 size 0x800
0x50090800 SEC_WDT1 size 0x800
0x500A0000 SEC_DAC size 0x800
0x500A0800 SEC_EADC size 0x800
0x500A1000 SEC_ADC0 size 0x100
0x500A1100 SEC_ADC1 size 0x100
0x50100000 SEC_RETRAM size 0x800
0x50100800 SEC_PMU size 0x800
0x50101800 SEC_COMP size 0x800
0x50102000 SEC_SYSCFGLP size 0x800
0x50102800 SEC_RTCALM size 0x800
0x50103000 SEC_RTC size 0x800
0x50103800 SEC_RTCANA size 0x800
0x50104000 SEC_GPIOA size 0x400
0x50104400 SEC_GPIOB size 0x400
0x50104800 SEC_GPIOC size 0x400
0x50104C00 SEC_GPIOD size 0x400
0x50105000 SEC_GPIOE size 0x400
0x50105400 SEC_GPIOF size 0x400
0x50105800 SEC_GPIOG size 0x400
0x50105C00 SEC_GPIOH size 0x400
0x50106000 SEC_GPIOI size 0x400
0x50106400 SEC_IOCTRL size 0x400
0x50106800 SEC_EXTI size 0x800
0x50107000 SEC_VGIO size 0x400
0x50108000 SEC_LPBTMR0 size 0x20
0x50109000 SEC_LPBTMR1 size 0x20
0x50200000 SEC_SYSCFG0 size 0x800
0x50201000 SEC_DCMI size 0x800
0x50202000 SEC_ETH0 size 0x2000
0x50204000 SEC_ETH1 size 0x2000
0x50206000 SEC_ENCENG size 0x800
0x50208000 SEC_FLASHA size 0x4000
0x5020C000 SEC_FLASHB size 0x4000
0x60000000 OSPI0 size 0x4000000 — OSPI0 Peripheral Interface
0x64000000 OSPI1 size 0x4000000
0x70000000 SEC_OSPI0 size 0x4000000
0x74000000 SEC_OSPI1 size 0x4000000

## Interrupts
0 CM33_MAILBOX (CRC) — CM33_MAILBOX interrupt
1 CM0_MAILBOX (CRC) — CM0_MAILBOX interrupt
2 REV2 (CRC) — REV2 interrupt
3 REV3 (CRC) — REV3 interrupt
4 I2S0 (CRC) — I2S0 interrupt
5 I2S1 (CRC) — I2S1 interrupt
6 USB_HS (CRC) — USB_HS interrupt
7 USB_FS (CRC) — USB_FS interrupt
8 OSPI0 (CRC) — OSPI0 interrupt
9 OSPI1 (CRC) — OSPI1 interrupt
10 FLASHA (CRC) — FLASHA interrupt
11 FLASHB (CRC) — FLASHB interrupt
12 ISO7816_0_1 (CRC) — ISO7816_0_1 interrupt
13 MEM_ECC (CRC) — MEM_ECC interrupt
14 BTMR0 (CRC) — BTMR0 interrupt
15 BTMR1 (CRC) — BTMR1 interrupt
16 BTMR2 (CRC) — BTMR2 interrupt
17 BTMR3 (CRC) — BTMR3 interrupt
18 BPWM0 (CRC) — BPWM0 interrupt
19 BPWM1 (CRC) — BPWM1 interrupt
20 BPWM2 (DMA0) — BPWM2 interrupt
21 BPWM3 (DMA0) — BPWM3 interrupt
22 SDIO0 (DMA0) — SDIO0 interrupt
23 SDIO1 (DMA0) — SDIO1 interrupt
24 RNG (DMA0) — RNG interrupt
25 EADC (DMA0) — EADC interrupt
26 SCR (DMA0) — SCR interrupt
27 CAN0 (DMA0) — CAN0 interrupt
28 CAN1 (DMA0) — CAN1 interrupt
29 ETMR0_UP (DMA0) — ETMR0_UP interrupt
30 ETMR0_BRK (DMA0) — ETMR0_BRK interrupt
31 ETMR0_CC (DMA0) — ETMR0_CC interrupt
32 ETMR0_TRG_COM (DMA0) — ETMR0_TRG_COM interrupt
33 ETMR1_UP (DMA0) — ETMR1_UP interrupt
34 ETMR1_BRK (DMA0) — ETMR1_BRK interrupt
35 ETMR1_CC (DMA0) — ETMR1_CC interrupt
36 ETMR1_TRG_COM (DMA0) — ETMR1_TRG_COM interrupt
37 GTMR0 (DMA0) — GTMR0 interrupt
38 GTMR1 (DMA0) — GTMR1 interrupt
39 GTMR2 (DMA0) — GTMR2 interrupt
40 GTMR3 (DMA1) — GTMR3 interrupt
{n+41} DMA0_CH{n} (DMA1) (n=0..7) — DMA0_CH{n} interrupt
49 REV49 (DMA1) — REV49 interrupt
50 REV50 (DMA1) — REV50 interrupt
51 ADC0 (DMA1) — ADC0 interrupt
52 ADC1 (DMA1) — ADC1 interrupt
53 ENCENG (DMA1) — ENCENG interrupt
54 ETH0_SBD (DMA1) — ETH0_SBD interrupt
55 ETH0_PMT (DMA1) — ETH0_PMT interrupt
56 ETH1_SBD (DMA1) — ETH1_SBD interrupt
57 ETH1_PMT (DMA1) — ETH1_PMT interrupt
58 DCMI (DMA1) — DCMI interrupt
59 REV59 (DMA1) — REV59 interrupt
{n+60} FLEXCOMM{n} (UART0) (n=0..13) — FLEXCOMM{n} interrupt
74 DMA1_CH0 (UART0) — DMA1_CH0 interrupt
75 DMA1_CH1 (UART0) — DMA1_CH1 interrupt
76 DMA1_CH2 (UART0) — DMA1_CH2 interrupt
77 DMA1_CH3 (UART0) — DMA1_CH3 interrupt
78 DMA1_CH4 (UART0) — DMA1_CH4 interrupt
79 DMA1_CH5 (UART0) — DMA1_CH5 interrupt
80 DMA1_CH6 (UART1) — DMA1_CH6 interrupt
81 DMA1_CH7 (UART1) — DMA1_CH7 interrupt
{n+82} EXTI{n} (UART1) (n=0..15) — EXTI{n} interrupt
98 I2C14 (UART1) — I2C14 interrupt
99 BDMA (UART1) — BDMA interrupt
100 UART14 (UART2) — UART14 interrupt
101 UART15 (UART2) — UART15 interrupt
102 UART16 (UART2) — UART16 interrupt
103 UART17 (UART2) — UART17 interrupt
104 UART18 (UART2) — UART18 interrupt
105 UART19 (UART2) — UART19 interrupt
106 ISO78162_3 (UART2) — ISO78162_3 interrupt
107 REV107 (UART2) — REV107 interrupt
108 BTMR4 (UART2) — BTMR4 interrupt
109 BTMR5 (UART2) — BTMR5 interrupt
110 BTMR6 (UART2) — BTMR6 interrupt
111 BTMR7 (UART2) — BTMR7 interrupt
112 BPWM4 (UART2) — BPWM4 interrupt
113 BPWM5 (UART2) — BPWM5 interrupt
114 BPWM6 (UART2) — BPWM6 interrupt
115 BPWM7 (UART2) — BPWM7 interrupt
116 FLASH0_HFM (UART2) — FLASH0_HFM interrupt
117 BSPI0 (UART2) — BSPI0 interrupt
118 BSPI1 (UART2) — BSPI1 interrupt
119 BSPI2 (UART2) — BSPI2 interrupt
120 BSPI3 (UART3) — BSPI3 interrupt
121 BSPI4 (UART3) — BSPI4 interrupt
122 BSPI5 (UART3) — BSPI5 interrupt
123 HFM_COP (UART3) — HFM_COP interrupt
124 RTC (UART3) — RTC interrupt
125 PMU (UART3) — PMU interrupt
126 RTCALM (UART3) — RTCALM interrupt
127 SYSCFGLP_ANA (UART3) — SYSCFGLP_ANA interrupt
128 LP_BTMR (UART3) — LP_BTMR interrupt
129 REV129 (UART3) — REV129 interrupt
130 MPMU_CMP (UART3) — MPMU_CMP interrupt
