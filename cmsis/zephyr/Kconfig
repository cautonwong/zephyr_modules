## cmsis/zephyr/Kconfig
```kconfig
config ZEPHYR_CMSIS_MODULE
	bool
	default y

config HAS_CMSIS_CORE
	bool
	select HAS_CMSIS_CORE_A if CPU_AARCH32_CORTEX_A
	select HAS_CMSIS_CORE_R if CPU_AARCH32_CORTEX_R

if HAS_CMSIS_CORE

config HAS_CMSIS_CORE_A
	bool

config HAS_CMSIS_CORE_R
	bool

endif
```

## hal/V32F20X_StdPeriph_Lib_V1.0.6/zephyr/Kconfig
```kconfig
# Professional Kconfig for V32F20X HAL

config HAS_V32F20X_HAL
	bool
	help
	  Enable V32F20X HAL

config VANGO_V32F20X_HAL_ADC
	bool
config VANGO_V32F20X_HAL_CAN
	bool
config VANGO_V32F20X_HAL_CLK
	bool
config VANGO_V32F20X_HAL_CRC
	bool
config VANGO_V32F20X_HAL_CRYPT
	bool
config VANGO_V32F20X_HAL_DAC
	bool
config VANGO_V32F20X_HAL_DMA
	bool
config VANGO_V32F20X_HAL_BDMA
	bool
config VANGO_V32F20X_HAL_FLASH
	bool
config VANGO_V32F20X_HAL_GPIO
	bool
config VANGO_V32F20X_HAL_I2C
	bool
config VANGO_V32F20X_HAL_I2S
	bool
config VANGO_V32F20X_HAL_MAILBOX
	bool
config VANGO_V32F20X_HAL_OSPI
	bool
config VANGO_V32F20X_HAL_PMU
	bool
config VANGO_V32F20X_HAL_RNG
	bool
config VANGO_V32F20X_HAL_RTC
	bool
config VANGO_V32F20X_HAL_SDIO
	bool
config VANGO_V32F20X_HAL_SPI
	bool
config VANGO_V32F20X_HAL_SYSCFG
	bool
config VANGO_V32F20X_HAL_TIMER
	bool
config VANGO_V32F20X_HAL_UART
	bool
config VANGO_V32F20X_HAL_WDT
	bool
config VANGO_V32F20X_HAL_MISC
	bool
```

## hal/V85XXP_Lib_V2.5/zephyr/Kconfig
```kconfig
# V85XXP HAL Kconfig - conditional inclusion per library module

config HAS_V85XXP_HAL
	bool
	help
	  Enable V85XXP HAL

config VANGO_V85XXP_HAL_ADC
	bool
config VANGO_V85XXP_HAL_ANA
	bool
config VANGO_V85XXP_HAL_CLK
	bool
config VANGO_V85XXP_HAL_CMP
	bool
config VANGO_V85XXP_HAL_CRYPT
	bool
config VANGO_V85XXP_HAL_DMA
	bool
config VANGO_V85XXP_HAL_FLASH
	bool
config VANGO_V85XXP_HAL_GPIO
	bool
config VANGO_V85XXP_HAL_I2C
	bool
config VANGO_V85XXP_HAL_ISO7816
	bool
config VANGO_V85XXP_HAL_LCD
	bool
config VANGO_V85XXP_HAL_PMU
	bool
config VANGO_V85XXP_HAL_PWM
	bool
config VANGO_V85XXP_HAL_RTC
	bool
config VANGO_V85XXP_HAL_SPI
	bool
config VANGO_V85XXP_HAL_TMR
	bool
config VANGO_V85XXP_HAL_U32K
	bool
config VANGO_V85XXP_HAL_UART
	bool
config VANGO_V85XXP_HAL_WDT
	bool
```

## soc/rn8xxx/boards/rn8xxx_board/Kconfig.board
```kconfig
config BOARD_RN8XXX_BOARD
    bool "RN8xxx Development Board"
    depends on SOC_SERIES_RN8XXX
```

## soc/rn8xxx/boards/rn8xxx_board/Kconfig.defconfig
```kconfig
if BOARD_RN8XXX_BOARD

config BOARD
    default "rn8xxx_board"

endif # BOARD_RN8XXX_BOARD
```

## soc/rn8xxx/drivers/Kconfig
```kconfig
# Drivers configuration
menu "RN8xxx Drivers"
    depends on SOC_SERIES_RN8XXX

config RN8XXX_GPIO
    bool "RN8xxx GPIO Driver"
    default y
    depends on GPIO

endmenu
```

## soc/rn8xxx/dts/bindings/renergy,rn8xxx-uart.yaml
```yaml
description: Renergy RN8XXX UART

compatible: "renergy,rn8xxx-uart"

include: uart-controller.yaml

properties:
    reg:
      required: true
    interrupts:
      required: true
```

## soc/rn8xxx/soc/arm/rn8xxx/Kconfig
```kconfig
# SoC selection
choice
    prompt "RN8xxx SoC Selection"
    depends on SOC_SERIES_RN8XXX

config SOC_RN8318
    bool "RN8318"

endchoice
```

## soc/rn8xxx/soc/arm/rn8xxx/Kconfig.defconfig
```kconfig
if SOC_SERIES_RN8XXX

config SOC_SERIES
    default "rn8xxx"

config SOC
    default "rn8318" if SOC_RN8318

endif # SOC_SERIES_RN8XXX
```

## soc/rn8xxx/soc/arm/rn8xxx/Kconfig.soc
```kconfig
# SoC configuration
config SOC_SERIES_RN8XXX
    bool "RN8xxx Series MCU"
    select ARM
    select CPU_CORTEX_M0
    select SOC_FAMILY_RN8XXX
    help
      Enable support for RN8xxx series
```

## soc/rn8xxx/zephyr/Kconfig
```kconfig
# Kconfig for RN8xxx SoC module
source "soc/arm/rn8xxx/Kconfig"
source "drivers/Kconfig"
```

## soc/v32f20x/boards/vango/v32f20x_board/Kconfig
```kconfig
# V32F20X Board Kconfig
# Each CPU target is selected via board qualifier (e.g. v32f20x_board/v32f20x/cpuapp)
# Zephyr auto-generates BOARD_V32F20X_BOARD_V32F20X_CPUAPP/CPUMETER based on the qualifier path

config BOARD_V32F20X_BOARD
	bool "Vango V32F20x Board"
	select SOC_SERIES_V32F20X
	select SOC_V32F20X_CPUAPP if BOARD_V32F20X_BOARD_V32F20X_CPUAPP
	select SOC_V32F20X_CPUAPP if BOARD_V32F20X_BOARD_V32F20X_CPUAPP_NS
	select SOC_V32F20X_CPUMETER if BOARD_V32F20X_BOARD_V32F20X_CPUMETER
```

## soc/v32f20x/boards/vango/v32f20x_board/board.yml
```yaml
board:
  name: v32f20x_board
  full_name: Vango V32F20x Board
  vendor: vango
  socs:
    - name: v32f20x
      variants:
        - name: cpumeter
          cpucluster: cpumeter
        - name: cpuapp
          cpucluster: cpuapp
        - name: cpuapp_ns
          cpucluster: cpuapp
```

## soc/v32f20x/boards/vango/v32f20x_board/v32f20x_board_v32f20x_cpuapp_cpuapp_ns_defconfig
```kconfig
CONFIG_SOC_V32F20X_CPUAPP=y
CONFIG_ARM_TRUSTZONE_M=y
CONFIG_TRUSTED_EXECUTION_NONSECURE=y
```

## soc/v32f20x/drivers/Kconfig
```kconfig
# Professional Drivers Kconfig for V32F20X
# Using strict rsource for hierarchical isolation

menu "V32F20X Drivers"
    depends on SOC_SERIES_V32F20X

# 1. Foundation Infrastructure
rsource "clock_control/Kconfig"
rsource "pinctrl/Kconfig"
rsource "reset/Kconfig"
rsource "dma/Kconfig"

# 2. IO & Bus Drivers
config V32F20X_GPIO
    bool "V32F20X GPIO Driver"
    default y
    depends on DT_HAS_VANGO_V32F20X_GPIO_ENABLED
    select GPIO
    help
      Enable support for Vango V32F20X GPIO controller.

config V32F20X_UART
    bool "V32F20X UART Driver"
    default y
    depends on DT_HAS_VANGO_V32F20X_UART_ENABLED
    select SERIAL_HAS_DRIVER
    select SERIAL_SUPPORT_INTERRUPT
    help
      Enable support for Vango V32F20X UART.

config I2C_V32F20X
    bool "V32F20X I2C Driver"
    default y
    depends on DT_HAS_VANGO_V32F20X_I2C_ENABLED
    select I2C
    help
      Enable support for Vango V32F20X I2C.

config SPI_V32F20X
    bool "V32F20X SPI Driver"
    default y
    depends on DT_HAS_VANGO_V32F20X_SPI_ENABLED
    select SPI
    help
      Enable support for Vango V32F20X SPI.

config CAN_V32F20X
    bool "V32F20X CAN Driver"
    default y
    depends on DT_HAS_VANGO_V32F20X_CAN_ENABLED
    select CAN
    help
      Enable support for Vango V32F20X CAN.

# 3. Analog & Specialized
config ADC_V32F20X
    bool "V32F20X ADC Driver"
    default y
    depends on DT_HAS_VANGO_V32F20X_ADC_ENABLED
    select ADC
    help
      Enable support for Vango V32F20X ADC.

rsource "timer/Kconfig"
rsource "watchdog/Kconfig"
rsource "flash/Kconfig"
rsource "entropy/Kconfig"

endmenu
```

## soc/v32f20x/drivers/analog/Kconfig
```kconfig
config ANA_CMP_V32F20X
    bool "Vango V32F20X Analog Comparator Driver"
    default y
    depends on DT_HAS_VANGO_V32F20X_ANA_CMP_ENABLED
    select VANGO_V32F20X_HAL_ANA
    help
      Enable the Vango V32F20X Analog Comparator driver for power fail detection.
```

## soc/v32f20x/drivers/clock_control/Kconfig
```kconfig
# Vango V32F20X Clock configuration options

config CLOCK_CONTROL_V32F20X
	bool "Vango V32F20X Clock driver"
	default y
	depends on DT_HAS_VANGO_V32F20X_CLOCK_ENABLED
	select VANGO_V32F20X_HAL_CLK
	select VANGO_V32F20X_HAL_SYSCFG
	help
	  Enable the Vango V32F20X Clock driver.
```

## soc/v32f20x/drivers/dma/Kconfig
```kconfig
config DMA_V32F20X
    bool "V32F20X DMA Driver"
    default y
    depends on DT_HAS_VANGO_V32F20X_DMA_ENABLED
    select DMA
    select VANGO_V32F20X_HAL_DMA if SOC_V32F20X_CPU1
    select VANGO_V32F20X_HAL_BDMA if SOC_V32F20X_CPU0
    help
      Enable support for Vango V32F20X DMA/BDMA controller.
```

## soc/v32f20x/drivers/flash/Kconfig
```kconfig
# Vango V32F20X Flash configuration options

config FLASH_V32F20X
	bool "Vango V32F20X Flash driver"
	default y
	select FLASH_HAS_DRIVER_ENABLED
	select FLASH_HAS_PAGE_LAYOUT
        select VANGO_V32F20X_HAL_FLASH
	help
	  Enable the Vango V32F20X Flash driver.
```

## soc/v32f20x/drivers/gpio/Kconfig
```kconfig
# Vango V32F20x GPIO configuration options

config GPIO_V32F20X
    bool "Vango V32F20x GPIO driver"
    default y
    depends on DT_HAS_VANGO_V32F20X_GPIO_ENABLED
    select GPIO
    select VANGO_V32F20X_HAL_GPIO
    help
      Enable the Vango V32F20x GPIO driver.
```

## soc/v32f20x/drivers/i2c/Kconfig
```kconfig
config I2C_V32F20X
    bool "V32F20X I2C Driver"
    default y
    depends on DT_HAS_VANGO_V32F20X_I2C_ENABLED
    select I2C
    select VANGO_V32F20X_HAL_I2C
    help
      Enable support for Vango V32F20X I2C.
```

## soc/v32f20x/drivers/mbox/Kconfig
```kconfig
# Vango V32F20x Mailbox configuration options

config MBOX_V32F20X
    bool "Vango V32F20x Mailbox driver"
    default y
    depends on DT_HAS_VANGO_V32F20X_MBOX_ENABLED
    select MBOX
    select VANGO_V32F20X_HAL_MAILBOX
    help
      Enable the Vango V32F20x Mailbox driver.
```
